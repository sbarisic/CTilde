## examples/ManagedShell/Modules/OverlayFixture/sdkconfig.defaults
```kconfig
CONFIG_ELF_LOADER=y
CONFIG_ELF_DYNAMIC_LOAD_SHARED_OBJECT=y
CONFIG_ELF_FILE_SYSTEM_BASE_PATH="/storage"
```

## examples/ManagedShell/Modules/TaskManager/sdkconfig.defaults
```kconfig
CONFIG_ELF_LOADER=y
CONFIG_ELF_DYNAMIC_LOAD_SHARED_OBJECT=y
CONFIG_ELF_FILE_SYSTEM_BASE_PATH="/storage"
CONFIG_FREERTOS_GENERATE_RUN_TIME_STATS=y
CONFIG_FREERTOS_RUN_TIME_COUNTER_TYPE_U64=y
CONFIG_FREERTOS_RUN_TIME_STATS_USING_ESP_TIMER=y
CONFIG_FREERTOS_USE_TRACE_FACILITY=y
```

## examples/ManagedShell/sdkconfig.defaults
```kconfig
CONFIG_PARTITION_TABLE_CUSTOM=y
CONFIG_PARTITION_TABLE_CUSTOM_FILENAME="partitions.csv"
CONFIG_ESPTOOLPY_FLASHSIZE_4MB=y
CONFIG_ELF_LOADER=y
CONFIG_ELF_DYNAMIC_LOAD_SHARED_OBJECT=y
CONFIG_ELF_FILE_SYSTEM_BASE_PATH="/storage/modules"
CONFIG_LITTLEFS_MAX_PARTITIONS=2
CONFIG_FREERTOS_THREAD_LOCAL_STORAGE_POINTERS=3
CONFIG_FREERTOS_GENERATE_RUN_TIME_STATS=y
CONFIG_FREERTOS_RUN_TIME_COUNTER_TYPE_U64=y
CONFIG_FREERTOS_RUN_TIME_STATS_USING_ESP_TIMER=y
CONFIG_FREERTOS_USE_TRACE_FACILITY=y
CONFIG_CTILDE_MANAGED_MAX_PROCESSES=16
CONFIG_FATFS_VOLUME_COUNT=4
CONFIG_FATFS_LFN_HEAP=y
CONFIG_FATFS_MAX_LFN=255
CONFIG_FATFS_API_ENCODING_UTF_8=y
CONFIG_FATFS_FS_LOCK=16
```

## examples/TCan485/sdkconfig.defaults
```kconfig
CONFIG_ESP_MAIN_TASK_STACK_SIZE=8192
CONFIG_ESP_CONSOLE_UART_CUSTOM=y
CONFIG_ESP_CONSOLE_UART_CUSTOM_NUM_0=y
CONFIG_ESP_CONSOLE_UART_BAUDRATE=460800
CONFIG_ESPTOOLPY_MONITOR_BAUD=460800
CONFIG_ESPTOOLPY_FLASHSIZE_4MB=y
CONFIG_PARTITION_TABLE_CUSTOM=y
CONFIG_PARTITION_TABLE_CUSTOM_FILENAME="partitions.csv"
CONFIG_PARTITION_TABLE_FILENAME="partitions.csv"
CONFIG_COMPILER_OPTIMIZATION_DEBUG=y
CONFIG_ESP_SYSTEM_GDBSTUB_RUNTIME=y
CONFIG_ESP_GDBSTUB_SUPPORT_TASKS=y
CONFIG_FREERTOS_THREAD_LOCAL_STORAGE_POINTERS=2
CONFIG_FREERTOS_TLSP_DELETION_CALLBACKS=y
CONFIG_ESP_HTTP_CLIENT_ENABLE_HTTPS=y
CONFIG_MBEDTLS_CERTIFICATE_BUNDLE=y
CONFIG_MBEDTLS_CERTIFICATE_BUNDLE_DEFAULT_FULL=y
```

## runtime/esp-idf/ctilde_managed_runtime/Kconfig
```kconfig
menu "C~ managed runtime"

config CTILDE_MANAGED_MEMORY_TRACE
    bool "Emit JSON memory samples at managed lifecycle boundaries"
    default n
    help
        Emit versioned CT_MEMORY JSON records to the firmware log. Samples are
        global heap observations, not per-process attribution or continuous
        peak measurements. Logging can affect timing. Use the same setting
        for baseline and comparison firmware.

config CTILDE_MANAGED_TLS_INDEX
    int "FreeRTOS TLS index"
    range 0 7
    default 2
    help
        TLS slot reserved for the C~ process and module execution context.

config CTILDE_MANAGED_MAX_MODULES
    int "Maximum loaded managed modules"
    range 4 64
    default 16

config CTILDE_MANAGED_MAX_PROCESSES
    int "Maximum concurrent managed process slots"
    range 16 256
    default 16

config CTILDE_MANAGED_MAX_CALL_DEPTH
    int "Maximum nested managed cross-module calls"
    range 16 256
    default 64
    help
        Maximum number of provider-owned managed call frames retained by one
        execution context. This is independent from the loaded-module limit.

endmenu
```
